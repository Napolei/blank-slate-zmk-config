## config/west.yml
```yaml
manifest:
  remotes:
    - name: petejohanson
      url-base: https://github.com/petejohanson
    - name: zmkfirmware
      url-base: https://github.com/zmkfirmware
    - name: urob
      url-base: https://github.com/urob
  projects:
    - name: zmk
      remote: zmkfirmware
      revision: v0.3
      import: app/west.yml
    - name: blank-slate-zmk-module
      remote: petejohanson
      revision: v0.3
    - name: zmk-helpers
      remote: urob
      revision: main
  self:
    path: config

parse_config:
  zmk_additional_includes: ["zmk-helpers/include"]
```
